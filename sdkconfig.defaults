## sdkconfig.defaults
```kconfig
# ===== 目标芯片 =====
CONFIG_IDF_TARGET="esp32s3"

# ===== Flash / PSRAM =====
CONFIG_ESPTOOLPY_FLASHSIZE_16MB=y
CONFIG_SPIRAM=y
CONFIG_SPIRAM_MODE_OCT=y
CONFIG_SPIRAM_SPEED_80M=y
CONFIG_SPIRAM_FETCH_INSTRUCTIONS=y
CONFIG_SPIRAM_RODATA=y

# ===== CPU 性能 =====
CONFIG_FREERTOS_HZ=1000
CONFIG_ESP_DEFAULT_CPU_FREQ_MHZ_240=y

# ===== LVGL / 显示 =====
CONFIG_LV_COLOR_DEPTH_16=y
CONFIG_LV_USE_LOG=n
CONFIG_LV_FONT_MONTSERRAT_14=y
CONFIG_LV_FONT_MONTSERRAT_20=y
CONFIG_LV_FONT_MONTSERRAT_24=y
CONFIG_LV_FONT_MONTSERRAT_48=y
CONFIG_LV_USE_CANVAS=y
CONFIG_LV_MEM_SIZE_KILOBYTES=192

# ===== 蓝牙：只开 BLE（手机推导航指令），经典蓝牙关闭 =====
CONFIG_BT_ENABLED=y
CONFIG_BT_BLUEDROID_ENABLED=y
CONFIG_BT_BLE_ENABLED=y
CONFIG_BT_CLASSIC_ENABLED=n
CONFIG_BT_GATTS_ENABLE=y
CONFIG_BT_GATTC_ENABLE=n
CONFIG_BT_BLE_SMP_ENABLE=n

# ===== 文件系统（SD 卡存地图瓦片）=====
CONFIG_FATFS_LFN_HEAP=y
CONFIG_FATFS_MAX_LFN=64

# ===== 主任务栈（LVGL 需要大栈）=====
CONFIG_ESP_MAIN_TASK_STACK_SIZE=8192
```
